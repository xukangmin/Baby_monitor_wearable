## CMakeLists.txt
```
cmake_minimum_required(VERSION 3.8.2)

find_package(Zephyr REQUIRED HINTS $ENV{ZEPHYR_BASE})
project(NONE)
zephyr_include_directories(inc)        #Add this line
include_directories(inc)

target_sources(app PRIVATE src/multiply.c)  #Add this line
target_sources(app PRIVATE src/main.c)
```

## prj.conf
```kconfig
CONFIG_SERIAL=y
```

## src/main.c
```c
#include <zephyr.h>
#include <sys/printk.h>
#include "multiply.h"

void main(void)
{
	int x = 5;
	int y = 2;
	int result = multiply(x, y);
	printk("%d times %d equals %d\n", x, y, result);
}
```

## inc/multiply.h
```c
#ifndef MULTIPLE_H

int multiply(int x, int y);

#endif
```

## src/multiply.c
```c
#include "multiply.h"

int multiply(int x, int y){
	return x*y;
}
```
