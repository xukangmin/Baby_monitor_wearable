## Firmware/baby_mon/max30102/zephyr/Kconfig
```kconfig
# MAX30101 heart rate sensor

# Copyright (c) 2017, NXP
# SPDX-License-Identifier: Apache-2.0

config MAX30102
	bool "MAX30102 Pulse Oximeter and Heart Rate Sensor"
	depends on I2C
```

## Firmware/baby_mon/max32664/zephyr/Kconfig
```kconfig
# MAX30101 heart rate sensor

# Copyright (c) 2017, NXP
# SPDX-License-Identifier: Apache-2.0

config MAX32664
	bool "MAX32664 Bio Sensor Hub Module"
	depends on I2C
```

## Firmware/hello_world/build/Kconfig/Kconfig.modules
```kconfig
menu "nrf (C:\Users\kangmin\ncs\v1.5.0\nrf)"
osource "C:/Users/kangmin/ncs/v1.5.0/nrf/Kconfig.nrf"
config ZEPHYR_NRF_MODULE
	bool
	default y
endmenu
menu "mcuboot (C:\Users\kangmin\ncs\v1.5.0\bootloader\mcuboot)"
osource "$(ZEPHYR_MCUBOOT_KCONFIG)"
config ZEPHYR_MCUBOOT_MODULE
	bool
	default y
endmenu
menu "nrfxlib (C:\Users\kangmin\ncs\v1.5.0\nrfxlib)"
osource "C:/Users/kangmin/ncs/v1.5.0/nrfxlib/Kconfig.nrfxlib"
config ZEPHYR_NRFXLIB_MODULE
	bool
	default y
endmenu
menu "cddl-gen (C:\Users\kangmin\ncs\v1.5.0\modules\lib\cddl-gen)"
osource "$(ZEPHYR_CDDL_GEN_KCONFIG)"
config ZEPHYR_CDDL_GEN_MODULE
	bool
	default y
endmenu
menu "hal_nordic (C:\Users\kangmin\ncs\v1.5.0\modules\hal\nordic)"
osource "$(ZEPHYR_HAL_NORDIC_KCONFIG)"
config ZEPHYR_HAL_NORDIC_MODULE
	bool
	default y
endmenu
menu "connectedhomeip (C:\Users\kangmin\ncs\v1.5.0\modules\lib\connectedhomeip)"
osource "C:/Users/kangmin/ncs/v1.5.0/modules/lib/connectedhomeip/config/nrfconnect/chip-module/Kconfig"
config ZEPHYR_CONNECTEDHOMEIP_MODULE
	bool
	default y
endmenu
```

## Firmware/hello_world/build_nrf52dk_nrf52832/Kconfig/Kconfig.shield
```kconfig
osource "C:/Users/kangmin/ncs/v1.5.0/nrf/boards/shields/*/Kconfig.shield"
osource "C:/Users/kangmin/ncs/v1.5.0/zephyr/boards/shields/*/Kconfig.shield"
osource "C:/Users/kangmin/ncs/v1.5.0/zephyr/boards/shields/*/Kconfig.shield"
```

## Firmware/hello_world/build_nrf52dk_nrf52832/Kconfig/Kconfig.shield.defconfig
```kconfig
osource "C:/Users/kangmin/ncs/v1.5.0/nrf/boards/shields/*/Kconfig.defconfig"
osource "C:/Users/kangmin/ncs/v1.5.0/zephyr/boards/shields/*/Kconfig.defconfig"
osource "C:/Users/kangmin/ncs/v1.5.0/zephyr/boards/shields/*/Kconfig.defconfig"
```

## Firmware/hello_world/build_nrf52dk_nrf52832/Kconfig/Kconfig.soc.arch
```kconfig
osource "C:/Users/kangmin/ncs/v1.5.0/zephyr/soc/$(ARCH)/Kconfig"
osource "C:/Users/kangmin/ncs/v1.5.0/zephyr/soc/$(ARCH)/*/Kconfig"
```

## Firmware/hello_world/nrf53dk/Kconfig/Kconfig.modules
```kconfig
menu "hal_nordic (C:\Users\kangmin\zephyrproject\modules\hal\nordic)"
osource "$(ZEPHYR_HAL_NORDIC_KCONFIG)"
config ZEPHYR_HAL_NORDIC_MODULE
	bool
	default y
endmenu
menu "sof (C:\Users\kangmin\zephyrproject\modules\audio\sof)"
osource "C:/Users/kangmin/zephyrproject/modules/audio/sof/zephyr/Kconfig"
config ZEPHYR_SOF_MODULE
	bool
	default y
endmenu
menu "trusted-firmware-m (C:\Users\kangmin\zephyrproject\modules\tee\tfm)"
osource "$(ZEPHYR_TRUSTED_FIRMWARE_M_KCONFIG)"
config ZEPHYR_TRUSTED_FIRMWARE_M_MODULE
	bool
	default y
endmenu
```

## Firmware/hello_world/nrf53dk/Kconfig/Kconfig.shield.defconfig
```kconfig
osource "C:/Users/kangmin/zephyrproject/zephyr/boards/shields/*/Kconfig.defconfig"
```

## Firmware/hello_world/nrf53dk/Kconfig/Kconfig.soc.arch
```kconfig
osource "C:/Users/kangmin/zephyrproject/zephyr/soc/$(ARCH)/Kconfig"
osource "C:/Users/kangmin/zephyrproject/zephyr/soc/$(ARCH)/*/Kconfig"
```
